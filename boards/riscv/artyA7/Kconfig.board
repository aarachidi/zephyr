## boards/riscv/artyA7/Kconfig.board
```kconfig
# SPDX-License-Identifier: Apache-2.0

config BOARD_ARTYA7
	bool "artyA7 target"
	depends on SOC_RISCV_E310ARTYA7
```

## boards/riscv/artyA7/Kconfig.defconfig
```kconfig
# SPDX-License-Identifier: Apache-2.0

if BOARD_ARTYA7

config BOARD
	default "artyA7"

config SYS_CLOCK_TICKS_PER_SEC
	default 128

config SPI_SIFIVE
	default y
	
config SERIAL_HAS_DRIVER
    	default y
	

config UART_SIFIVE
	bool
	default y
	

config GPIO_SIFIVE
	default y


config PWM_SIFIVE
	default y


endif
```

## soc/riscv/riscv-privilege/E310ARTYA7/Kconfig.soc
```kconfig
# RISCV_SIFIVE_FREEDOM SOC configuration options

# Copyright (c) 2017 Jean-Paul Etienne <fractalclone@gmail.com>
# SPDX-License-Identifier: Apache-2.0


config SOC_RISCV_E310ARTYA7
	bool "E310ARTYA7 SOC implementation"
	select ATOMIC_OPERATIONS_C
	select INCLUDE_RESET_VECTOR
```
